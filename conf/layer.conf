## meta-mediatek/conf/machine/radxa-nio12b-norboot-ufs.conf
```bitbake
require conf/machine/include/mt8195.inc
require conf/machine/include/mt7921.inc
require conf/machine/include/mt7925.inc
require conf/machine/include/ubifs-macronix-mx25u12832F.inc
require conf/machine/include/radxa.inc

# The MT8195 firmware DTB/DTBO set needs more than the stock 2MiB NOR
# firmware partition. Use 2.5MiB firmware partitions in the 16MiB layout.
UBIFS_MAX_LEB_CNT = "40"
UBIFS_VOL_SIZE_FIRMWARE_A = "2354688"
UBIFS_VOL_SIZE_FIRMWARE_B = "2354688"

# Kernel
KERNEL_DEVICETREE = "mediatek/mt8395-genio-1200-radxa-nio12b-ufs.dtb"
# Shared IMX214 dual-cam overlay (CAM0 PDN GPIO54, 3V3 GPIO104)
KERNEL_DEVICETREE_OVERLAYS_AUTOLOAD = "video.dtbo apusys.dtbo nio12b-camera-imx214-4lan.dtbo"

#FIXME U-Boot for nor support
UBOOT_MACHINE = "genio_1200_radxa_nio12b_norboot_ufs_defconfig"

#FIXME libdram for nor support
LIBDRAM_BOARD_NAME = "genio-1200-evk-ufs"

# OP-TEE
OPTEE_DRAM_SIZE = "0x200000000"

# LK
LK_PROJECT = "mt8395-evk-norboot-ufs"
LK_BOARD_NAME = "${LK_PROJECT}"

# Trusted Firmware-A
TFA_NOR_FIP_ADDR = "0x200000"
TFA_NOR_FIP_LENGTH = "0x300000"
TFA_NOR_DRAMK_ADDR = "0xD00000"
TFA_NOR_MISC_ADDR = "0xD80000"

# UFS storage
WIC_SECTOR_SIZE = "4096"
WIC_BLOCK_SIZE = "4096"

OVERRIDES .= ":nor-boot"

MACHINE_FEATURES:append = " nor-boot ufs-system"
MACHINE_FEATURES:append = " alsa bluetooth pci usbgadget usbhost wifi tsn uc-fde"
IMAGE_INSTALL:append = " \
    rkwifibt-firmware-aic8800d80-usb \
"

MACHINEOVERRIDES =. "mt8395-evk:genio-1200-evk:mt8395-evk-norboot-ufs:genio-1200-evk-norboot-ufs:genio-1200-radxa-nio12b-norboot-ufs:"
```

## meta-mediatek/conf/machine/radxa-nio12b.conf
```bitbake
require conf/machine/include/mt8195.inc
require conf/machine/include/mt7921.inc
require conf/machine/include/mt7925.inc
require conf/machine/include/radxa.inc

# Kernel
KERNEL_DEVICETREE = "mediatek/mt8395-genio-1200-radxa-nio12b-ufs.dtb"
# Shared IMX214 dual-cam overlay (CAM0 PDN GPIO54, 3V3 GPIO104)
KERNEL_DEVICETREE_OVERLAYS_AUTOLOAD = "gpu-mali.dtbo video.dtbo apusys.dtbo nio12b-camera-imx214-4lan.dtbo"

LIST_DTBO = " gpu-mali.dtbo video.dtbo apusys.dtbo"
BOOT_CONF = "\#conf-mediatek_genio-1200-radxa-nio12b-ufs.dtb\#conf-gpu-mali.dtbo\#conf-video.dtbo\#conf-apusys.dtbo"

# U-Boot
UBOOT_MACHINE = "genio_1200_radxa_nio12b_ufs_defconfig"

# libdram
LIBDRAM_BOARD_NAME = "genio-1200-evk"

# OP-TEE
OPTEE_DRAM_SIZE = "0x200000000"

# LK
LK_PROJECT = "mt8395-evk-ufs"
LK_BOARD_NAME = "${LK_PROJECT}"

# UFS storage
WIC_SECTOR_SIZE = "4096"
WIC_BLOCK_SIZE = "4096"
MACHINE_FEATURES:append = " ufs-boot ufs-system "

MACHINE_FEATURES:append = " alsa bluetooth pci usbgadget usbhost wifi tsn uc-fde"

IMAGE_INSTALL:append = " \
    rkwifibt-firmware-aic8800d80-usb \
"

MACHINEOVERRIDES =. "mt8395-evk:genio-1200-evk:mt8395-evk-ufs:genio-1200-evk-ufs:genio-1200-radxa-nio12b"
```

## meta-qualcomm/conf/machine/radxa-dragon-q6a.conf
```bitbake
# Copyright (c) 2026 Radxa Computer (Shenzhen) Co., Ltd.
# Released under the MIT license (see COPYING.MIT for the terms)

#@TYPE: Machine
#@NAME: Radxa Dragon Q6A

require conf/machine/include/qcom-qcs6490.inc
require conf/machine/include/radxa.inc

# NOTE: TPM hardware is only present on rb3gen2-industrial kit
MACHINE_FEATURES += "efi m2connector pci phone"

KERNEL_DEVICETREE ?= " \
                      qcom/qcs6490-radxa-dragon-q6a.dtb \
                      "

# These DTs are not upstreamed and currently exist only in linux-qcom kernels
LINUX_QCOM_KERNEL_DEVICETREE ?= " \
                      qcom/kodiak-el2.dtbo \
                      qcom/kodiak-staging.dtbo \
                      qcom/qcs5430-fps-camx.dtbo \
                      "

MACHINE_ESSENTIAL_EXTRA_RRECOMMENDS += " \
    packagegroup-rb3gen2-firmware \
    packagegroup-rb3gen2-hexagon-dsp-binaries \
    qairt-sdk-hexagon-v68 \
    qcom-fastcv-binaries-thundercomm-rb3gen2-dsp \
    qps615-dlkm \
"

QCOM_CDT_FILE = "cdt_core_kit"
QCOM_BOOT_FILES_SUBDIR = "qcm6490"
QCOM_PARTITION_FILES_SUBDIR ?= "partitions/qcs6490-radxa-dragon-q6a/ufs"

QCOM_BOOT_FIRMWARE = "firmware-qcom-boot-qcs6490"
QCOM_CDT_FIRMWARE = "firmware-qcom-cdt-qcs6490"

# Isolate rt cpu
QCOM_RT_CPU        = "7"
QCOM_IRQAFF        = "0-6"
QCOM_RCU_NOCBS     = "7"
QCOM_RCU_EXPEDITED = "1"
QCOM_CPUIDLE_OFF   = "1"

UBOOT_CONFIG = "qcs6490-radxa-dragon-q6a"
```
