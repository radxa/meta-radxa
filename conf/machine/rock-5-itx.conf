## conf/machine/rock-5-itx.conf
```bitbake
# Copyright (c) 2021, Rockchip Electronics Co., Ltd
# Copyright (c) 2024 Radxa Computer (Shenzhen) Co., Ltd.
# Released under the MIT license (see COPYING.MIT for the terms)

#@TYPE: Machine
#@NAME: RK3588 ROCK 5 ITX

require conf/machine/include/rk3588.inc

KERNEL_DEVICETREE = "rockchip/rk3588-rock-5-itx.dtb"

UBOOT_MACHINE = "rk3588_defconfig"
```
